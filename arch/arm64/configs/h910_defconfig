## arch/arm64/configs/h910_defconfig
```kconfig
include common

#
# Networking options
#
CONFIG_IP_ROUTE_CLASSID=y
CONFIG_DEFAULT_BIC=y
CONFIG_DEFAULT_TCP_CONG="bic"

#
# Xtables matches
#
CONFIG_NETFILTER_XT_MATCH_DSCP=y

#
# IP: Netfilter Configuration
#
CONFIG_IP_NF_SECURITY=y

#
# IPv6: Netfilter Configuration
#
CONFIG_IP6_NF_NAT=y

#
# Classification
#
CONFIG_NET_CLS_BASIC=y
CONFIG_NET_CLS_TCINDEX=y
CONFIG_NET_CLS_ROUTE4=y
CONFIG_CLS_U32_PERF=y
CONFIG_NET_CLS_RSVP=y
CONFIG_NET_CLS_RSVP6=y
CONFIG_NET_CLS_CGROUP=y
CONFIG_NET_ACT_GACT=y
CONFIG_GACT_PROB=y
CONFIG_NET_ACT_MIRRED=y
CONFIG_NET_ACT_IPT=y
CONFIG_NET_ACT_NAT=y
CONFIG_NET_ACT_PEDIT=y
CONFIG_NET_ACT_SIMP=y
CONFIG_NET_ACT_SKBEDIT=y
CONFIG_NET_ACT_CSUM=y
CONFIG_NET_CLS_IND=y
CONFIG_CGROUP_NET_CLASSID=y

#
# USB GPIO expanders:
#
CONFIG_LGE_PM_VZW_REQ=y
CONFIG_LGE_PM_BATT_MANAGER=y

#
# LGE Board Selection
#
CONFIG_MACH_MSM8996_ELSA_ATT_US=y

#
# LGE QFPROM Values
#
CONFIG_LGE_PM_LGE_POWER_CLASS_VZW_REQ=y

#
# Pseudo filesystems
#
CONFIG_CRYPTO_DEV_HWCRYPTO_FOR_SDCARD=y
```

## arch/arm64/configs/h918_defconfig
```kconfig
include common

#
# ARM errata workarounds via the alternatives framework
#
CONFIG_CMA_PINPAGE_MIGRATION=y

#
# Networking options
#
CONFIG_DEFAULT_CUBIC=y
CONFIG_DEFAULT_TCP_CONG="cubic"
CONFIG_LGP_DATA_BUGFIX_IPV6_ADDRCONF_KERNEL_CRASH=y

#
# Xtables matches
#
CONFIG_NETFILTER_XT_MATCH_DSCP=y

#
# IP: Netfilter Configuration
#
CONFIG_IP_NF_SECURITY=y

#
# Classification
#
CONFIG_NET_ACT_GACT=y
CONFIG_NET_ACT_MIRRED=y
CONFIG_NET_ACT_SKBEDIT=y

#
# LGE Board Selection
#
CONFIG_MACH_MSM8996_ELSA_TMO_US=y

#
# TouchSense driver support
#
CONFIG_TRUSTONIC_TEE=y
CONFIG_TRUSTONIC_TEE_LPAE=y
```

## arch/arm64/configs/ls997_defconfig
```kconfig
include common

#
# Networking options
#
CONFIG_DEFAULT_BIC=y
CONFIG_DEFAULT_TCP_CONG="bic"

#
# IPv6: Netfilter Configuration
#
CONFIG_IP6_NF_NAT=y

#
# USB GPIO expanders:
#
CONFIG_LGE_PM_OTP_SCENARIO_FOR_SPRINT=y

#
# USB Peripheral Controller
#
CONFIG_LGE_USB_DIAG_LOCK_SPR=y

#
# LGE Board Selection
#
CONFIG_MACH_MSM8996_ELSA_SPR_US=y

#
# LGE QFPROM Values
#
CONFIG_MEM_SHARE_QMI_SERVICE=y
```

## arch/arm64/configs/vs995_defconfig
```kconfig
include common

#
# ARM errata workarounds via the alternatives framework
#
CONFIG_CMA_PINPAGE_MIGRATION=y

#
# Networking options
#
CONFIG_DEFAULT_CUBIC=y
CONFIG_DEFAULT_TCP_CONG="cubic"

#
# Xtables matches
#
CONFIG_NETFILTER_XT_MATCH_DSCP=y

#
# IP: Netfilter Configuration
#
CONFIG_IP_NF_SECURITY=y

#
# Classification
#
CONFIG_NET_ACT_GACT=y
CONFIG_NET_ACT_MIRRED=y
CONFIG_NET_ACT_SKBEDIT=y

#
# USB GPIO expanders:
#
CONFIG_LGE_PM_VZW_REQ=y
CONFIG_LGE_PM_WEAK_BATT_PACK=y
CONFIG_LGE_PM_OTP_SCENARIO_FOR_VZW=y

#
# Debugging features
#
CONFIG_LGE_USB_BC_12_VZW=y

#
# USB Miscellaneous drivers
#
CONFIG_LGE_USB_ANX7688_ADC=y

#
# USB Peripheral Controller
#
CONFIG_LGE_USB_G_AUTORUN=y
CONFIG_LGE_USB_G_CDROM_MAC_SUPPORT=y
CONFIG_LGE_USB_G_AUTORUN_VZW=y
CONFIG_LGE_USB_DIAG_LOCK_VZW=y

#
# LGE Board Selection
#
CONFIG_MACH_MSM8996_ELSA_VZW=y

#
# LGE Specific Patches
#
CONFIG_LGE_QSDL_SUPPORT=y

#
# LGE QFPROM Values
#
CONFIG_LGE_PM_LGE_POWER_CLASS_VZW_REQ=y

#
# TouchSense driver support
#
CONFIG_TRUSTONIC_TEE=y
CONFIG_TRUSTONIC_TEE_LPAE=y
```
